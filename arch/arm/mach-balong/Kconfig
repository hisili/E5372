## arch/arm/mach-balong/Kconfig
```kconfig
if ARCH_BALONG
choice
	prompt "Hisilicon SoC types"
	default ARCH_SOC_VERSION_P500_C00

config ARCH_SOC_VERSION_V3R2_C00
	bool "SOC_VERSION_V3R2_C00"
	select CPU_V7
	select ARM_GIC
	help
	  Support for Hisilicon(R) SoC VERSION_V3R2_C00.

config ARCH_SOC_VERSION_V3R2_ES
	bool "SOC_VERSION_V3R2_ES"
	select CPU_V7
	select ARM_GIC
	help
	  Support for Hisilicon(R) SoC VERSION_V3R2_ES.
 
config ARCH_SOC_VERSION_P500_C00
	bool "SOC_VERSION_P500_C00"
	select CPU_V7
	select ARM_GIC
	help
	  Support for Hisilicon(R) SoC VERSION_P500_C00.

config ARCH_SOC_VERSION_V7R1_C00
        bool "SOC_VERSION_V7R1_C00"
        select CPU_V7
        select ARM_GIC
        help
          Support for Hisilicon(R) SoC VERSION_V7R1_C00.        
	 

endchoice

choice
	prompt "Hisilicon Balong Board Type"
	default MACH_

config MACH_BOARD_SFT
	select HAS_BALONG_DEBUG_UART_PHYS
	select ARCH_WANT_OPTIONAL_GPIOLIB
	bool "BALONGBOARD_SFT"
	help
	  Support for the Hisilicon Balong SFT V100R001 board.

config MACH_BOARD_FPGA
	select HAS_BALONG_DEBUG_UART_PHYS
	select ARCH_WANT_OPTIONAL_GPIOLIB
	bool "BALONGBOARD_FPGA"
	help
	  Support for the Hisilicon Balong FPGA V100R001 board.

config MACH_BOARD_ES
	select HAS_BALONG_DEBUG_UART_PHYS
	select ARCH_WANT_OPTIONAL_GPIOLIB
	bool "BALONGBOARD_ES"
	help
	  Support for the Hisilicon Balong V300R002 ES board.

endchoice

config BALONG_MULTICORE
	bool "balong mutilcore support"
	help
	Support for the Hisilicon Balong mutilcore.

config BALONG_MULTICORE_TEST
	bool "balong mutilcore test support"
	help
	Support for the Hisilicon Balong mutilcore test.


config BALONG_EASY_SHELL
	bool "balong easy shell(ecall) support"
	default y
	help
	Support for the Hisilicon Balong easy shell.

config BALONG_OM
	bool "balong om support"
	help
	Support for the Hisilicon Balong OM team interface.

config BALONG_MEMORY_SPINLOCK
	bool "balong memory spinlock support"
	default y 
	help
	Support for the Hisilicon Balong p500 smp cpu memory spinlock.

config HAS_BALONG_DEBUG_UART_PHYS
	bool

if HAS_BALONG_DEBUG_UART_PHYS
choice
	prompt "Debug UART"

	default BALONG_DEBUG_UART_NONE

	config BALONG_DEBUG_UART_NONE
		bool "NONE"

	config BALONG_DEBUG_UART0
		bool "UART0"

	config BALONG_DEBUG_UART1
		bool "UART1"

	config BALONG_DEBUG_UART2
		bool "UART2"
		
	config BALONG_DEBUG_UART3
		bool "UART3"
endchoice
endif
endif
```

## drivers/dmac/Kconfig
```kconfig
#
# balong dmac drivers
#

comment "balong dmac drivers"
	  
config BALONG_DMAC
	tristate "balong dmac support"
	help
	Support for the Hisilicon Balong dmac.
```

## drivers/input/keyboard/balong_keyboard/Kconfig
```kconfig
config BALONG_KEYBOARD_GPIO
	tristate "Balong GPIO Buttons"
	depends on ARCH_BALONG && GPIO_BALONG
	help
	  Balong gpio for E5
```

## drivers/led_drv/Kconfig
```kconfig
menuconfig LED_DRV
	bool "LED_DRV Support"
	help
	  Say Y to enable Linux LED_DRV support.  This allows control of supported
	  LED_DRV from both userspace and optionally, by kernel events.

if LED_DRV

config LED_DRV
	tristate "LED Default ON"
	help
	  This allows LED_DRV to be initialised in the ON state.
	  If unsure, say Y.
	  
endif # CONNECTOR
```

## drivers/pmu/Kconfig
```kconfig
#
# Multicore PMU drivers
#

comment "Multicore PMU drivers"

config PMU_ACORE
	tristate "Multicore pmu support"
	help
	  Multicore pmu drivers
```

## drivers/staging/balong_lcd/Kconfig
```kconfig
config BALONG_LCD_SPI
	tristate "Balong LCD Driver via SPI"
	default N
	---help---
	  Enable support for the LCD display in Balong platform.
```

## drivers/staging/balong_oled/Kconfig
```kconfig
config BALONG_OLED
	tristate "Balong OLED driver"
	default N
	---help---
	  Enable support for the OLED display in Balong platform.
```

## drivers/staging/balong_oled_emi/Kconfig
```kconfig
config BALONG_OLED_EMI
	tristate "Balong OLED driver via EMI Bus"
	default N
	---help---
	  Enable support for the OLED display via EMI bus in Balong platform.
```

## drivers/staging/balong_tft_emi/Kconfig
```kconfig
config BALONG_TFT_EMI
	tristate "Balong TFT driver via EMI Bus"
	default N
	---help---
	  Enable support for the TFT display via EMI bus in Balong platform.
```

## drivers/timer/Kconfig
```kconfig
#
# balong timer drivers
#

comment "balong timer drivers"
	  
config BALONG_TIMER
	tristate "balong timer support"
	help
	Support for the Hisilicon Balong timer.
```

## drivers/wlan_if/Kconfig
```kconfig
#
# WLAN subsystem configuration
#


config WLAN_IF
	bool "wlan interface"
	help
	      wlan interface
config WLAN_IF_BCM43239
	bool "wlan interface"
	default y
	depends on WLAN_IF
	help
	      wlan interface
```
